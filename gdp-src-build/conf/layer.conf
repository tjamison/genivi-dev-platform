## gdp-src-build/conf/layer.conf
```bitbake
# We have a conf and classes directory, add to BBPATH
BBPATH =. "${LAYERDIR}:"

# We have recipes-* directories, add to BBFILES
BBFILES += "${LAYERDIR}/recipes-*/*/*.bb \
            ${LAYERDIR}/recipes-*/*/*.bbappend"

BBFILE_COLLECTIONS += "genividev"
BBFILE_PATTERN_genividev = "^${LAYERDIR}/"
BBFILE_PRIORITY_genividev = "7"

# Add smart-cities-pilot specific layers
BBLAYERS += " \
  ${TOPDIR}/../meta-smart-cities-pilot \
  ${TOPDIR}/../meta-openembedded/meta-networking \
  ${TOPDIR}/../meta-openembedded/meta-python \
"

# This should only be incremented on significant changes that will
# cause compatibility issues with other layers
LAYERVERSION_genividev = "1"

LAYERDEPENDS_genividev = "ivi"
```
